/*
 * Copyright (c) 2021 The ZMK Contributors
 *
 * SPDX-License-Identifier: MIT
 */

#include "a_dux_trackpad.dtsi"


	
/ {
	        kscan0: kscan {
        compatible = "zmk,kscan-gpio-direct";
        wakeup-source;

        input-gpios =
            <&pro_micro  5 (GPIO_ACTIVE_LOW | GPIO_PULL_UP)>,
            <&pro_micro  0 (GPIO_ACTIVE_LOW | GPIO_PULL_UP)>,
            <&pro_micro 18 (GPIO_ACTIVE_LOW | GPIO_PULL_UP)>,
            <&pro_micro 16 (GPIO_ACTIVE_LOW | GPIO_PULL_UP)>,
            <&pro_micro 21 (GPIO_ACTIVE_LOW | GPIO_PULL_UP)>,
            <&pro_micro  6 (GPIO_ACTIVE_LOW | GPIO_PULL_UP)>,
            <&pro_micro  3 (GPIO_ACTIVE_LOW | GPIO_PULL_UP)>,
            <&pro_micro 19 (GPIO_ACTIVE_LOW | GPIO_PULL_UP)>,
            <&pro_micro 14 (GPIO_ACTIVE_LOW | GPIO_PULL_UP)>,
            <&pro_micro 20 (GPIO_ACTIVE_LOW | GPIO_PULL_UP)>,
            <&pro_micro  7 (GPIO_ACTIVE_LOW | GPIO_PULL_UP)>,
            <&pro_micro  4 (GPIO_ACTIVE_LOW | GPIO_PULL_UP)>,
            <&pro_micro  1 (GPIO_ACTIVE_LOW | GPIO_PULL_UP)>,
            <&pro_micro 15 (GPIO_ACTIVE_LOW | GPIO_PULL_UP)>,
            <&pro_micro 10 (GPIO_ACTIVE_LOW | GPIO_PULL_UP)>,
            <&pro_micro  8 (GPIO_ACTIVE_LOW | GPIO_PULL_UP)>,
            <&pro_micro  9 (GPIO_ACTIVE_LOW | GPIO_PULL_UP)>
        ;
    };

    /* define virtual input, will be resurrected for emitting input event */
	/* NOTE: set `device = <&glidepoint1>` in `zmk,input-listener` */
	glidepoint1: virtual_input {
		compatible = "zmk,virtual-input";
	};

	/* for central side, define (relay-channel)-to-(virtual-input) mapping */
	input_relay_config_102 {
		compatible = "zmk,split-peripheral-input-relay";
		
		/* channel id, used to filter incoming input event from split peripheral */
		/* NOTE: should matching relay-channel on peripheral overlay */
		relay-channel = <102>;

		/* virtual input device on central, which used to emit input event as an agent device */
		device = <&glidepoint1>;
	};
};

