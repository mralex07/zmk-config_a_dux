## config/boards/shields/Keiler/Kconfig.defconfig
```kconfig
if SHIELD_KEILER_LEFT || SHIELD_KEILER_RIGHT
config ZMK_KEYBOARD_NAME
    default "Keiler"
endif

if SHIELD_KEILER_LEFT
config ZMK_SPLIT_ROLE_CENTRAL
    default y
endif

if SHIELD_KEILER_LEFT || SHIELD_KEILER_RIGHT
config ZMK_SPLIT
    default y

config ZMK_BLE
    default y
endif
```

## config/boards/shields/Keiler/Kconfig.shield
```kconfig
config SHIELD_KEILER_LEFT
	def_bool $(shields_list_contains,Keiler_left)

config SHIELD_KEILER_RIGHT
	def_bool $(shields_list_contains,Keiler_right)
```

## config/boards/shields/a_dux_trackpad/Kconfig.shield
```kconfig
# Copyright (c) 2021 The ZMK Contributors
# SPDX-License-Identifier: MIT

config SHIELD_A_DUX_TRACKPAD_LEFT
    def_bool $(shields_list_contains,a_dux_trackpad_left)

config SHIELD_A_DUX_TRACKPAD_RIGHT
    def_bool $(shields_list_contains,a_dux_trackpad_right)
```
